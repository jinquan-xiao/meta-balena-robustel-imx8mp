## conf/layer.conf
```bitbake
BBPATH .= ":${LAYERDIR}"

BBFILES += "${LAYERDIR}/recipes-*/*/*.bb \
            ${LAYERDIR}/recipes-*/*/*.bbappend"

BBFILE_COLLECTIONS += "balena-eg5120-imx8mp"
BBFILE_PATTERN_balena-eg5120-imx8mp := "^${LAYERDIR}/"
BBFILE_PRIORITY_balena-eg5120-imx8mp = "1337"
LAYERSERIES_COMPAT_balena-eg5120-imx8mp = "kirkstone"
```

## conf/machine/eg5120-imx8mp.conf
```bitbake
#@TYPE: Machine
#@NAME: i.MX8MP based Robustel Edge Gateway
#@SOC: i.MX8MP
#@DESCRIPTION: Machine configuration for i.MX8MP based Robustel Edge Gateway

MACHINEOVERRIDES = "imx8mp-rbt:${MACHINE}"
include conf/machine/imx8mp-rbt.conf
```

## conf/machine/imx8mp-rbt.conf
```bitbake
#@TYPE: Machine
#@NAME: Robustel EG5120 based on iMX8MP
#@SOC: i.MX8MP
#@DESCRIPTION: Machine configuration for Robustel EG5120
#@MAINTAINER: machangbao <machangbao110@sina.com>
#
# http://www.robustel.com

MACHINEOVERRIDES =. "mx8mp:"

require conf/machine/include/imx-base.inc
require conf/machine/include/arm/armv8a/tune-cortexa53.inc

require robustel.inc

# Robustel BSP default providers
PREFERRED_PROVIDER_virtual/kernel:imx8mp-rbt ?= "linux-imx"
PREFERRED_PROVIDER_u-boot:imx8mp-rbt ?= "u-boot-imx"
PREFERRED_PROVIDER_u-boot-fw-utils:imx8mp-rbt ?= "u-boot-fw-utils"
PREFERRED_PROVIDER_virtual/bootloader:imx8mp-rbt ?= "u-boot-imx"

KERNEL_DEVICETREE = " \
	freescale/imx8mp-eg5120.dtb \
	freescale/overlays/eg5120-kza-zaa.dtbo \
	freescale/overlays/eg5120-if-can1.dtbo \
	freescale/overlays/eg5120-if-uart1-rs232.dtbo \
	freescale/overlays/eg5120-if-uart1-rs485.dtbo \
	freescale/overlays/eg5120-if-uart3-rs232.dtbo \
	freescale/overlays/eg5120-if-uart3-rs485.dtbo \
	freescale/overlays/eg5120-wireless-wifi5.dtbo \
	freescale/overlays/eg5120-wireless-lora.dtbo \
"

MACHINE_EXTRA_RRECOMMENDS:remove = " imx-m7-demos"

UBOOT_CONFIG ??= "sd"
UBOOT_CONFIG[sd] = "imx8mp_eg5120_defconfig,sdcard"
SPL_BINARY = "spl/u-boot-spl.bin"

ATF_PLATFORM = "imx8mp"
ATF_LOAD_ADDR = "0x970000"

# Set DDR FIRMWARE
DDR_FIRMWARE_NAME = " \
	lpddr4_pmu_train_1d_dmem_202006.bin \
	lpddr4_pmu_train_1d_imem_202006.bin \
	lpddr4_pmu_train_2d_dmem_202006.bin \
	lpddr4_pmu_train_2d_imem_202006.bin \
"

# Set U-Boot DTB
UBOOT_DTB_NAME  = "imx8mp-evk.dtb"
UBOOT_DTB_EXTRA = ""

# Set imx-mkimage boot target
IMXBOOT_TARGETS = "flash_evk"
#IMXBOOT_TARGETS = "flash_hdmi_spl_uboot"

IMX_BOOT_SOC_TARGET = "iMX8MP"

# Extra firmware package name, that is required to build boot container for fslc bsp
IMX_EXTRA_FIRMWARE = "firmware-imx-8m"

SERIAL_CONSOLES = "115200;ttymxc0 115200;ttymxc1"

IMAGE_BOOTLOADER = "imx-boot"

ROOTFS_SIZE = "3700"
LOADADDR = ""
UBOOT_SUFFIX = "bin"
UBOOT_MAKE_TARGET = "all"
IMX_BOOT_SEEK = "32"

PREFERRED_PROVIDER_u-boot:imx8mp-rbt = "u-boot-imx"
PREFERRED_PROVIDER_virtual/bootloader:imx8mp-rbt = "u-boot-imx"
```
